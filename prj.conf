## prj.conf
```kconfig
CONFIG_STDOUT_CONSOLE=y
CONFIG_GPIO=y
CONFIG_SERIAL=y
CONFIG_UART_INTERRUPT_DRIVEN=y
CONFIG_USB_DEVICE_INITIALIZE_AT_BOOT=n

CONFIG_USB_DEVICE_STACK=y
CONFIG_USB_DEVICE_PID=0x000C
CONFIG_USB_DEVICE_BT_H4=y
CONFIG_BT_CTLR_DTM_HCI=y

# Workaround: Unable to allocate command buffer when using K_NO_WAIT since
# Host number of completed commands does not follow normal flow control.
CONFIG_BT_BUF_CMD_TX_COUNT=10
```

## boards/nrf52840dongle_nrf52840.conf
```kconfig
# USB CDC is on by default in nRF52840 Dongle. It interferes with BLE HCI interface, so we turn it off.
CONFIG_BOARD_SERIAL_BACKEND_CDC_ACM=n
CONFIG_USB_CDC_ACM=n
```

## boards/nrf52840dongle_nrf52840.overlay
```dts
/ {
	chosen {
		zephyr,console = &uart0;
		zephyr,shell-uart = &uart0;
		zephyr,uart-mcumgr = &uart0;
		zephyr,bt-mon-uart = &uart0;
		zephyr,bt-c2h-uart = &uart0;
	};
};

zephyr_udc0: &usbd {
	compatible = "nordic,nrf-usbd";
	status = "okay";

	cdc_acm_uart: cdc_acm_uart {
		compatible = "zephyr,cdc-acm-uart";
		status = "disabled";
	};
};
```

## src/main.c
```c
/*
 * Copyright (c) 2023 Blue Clover
 * Copyright (c) 2020 Intel Corporation
 *
 * SPDX-License-Identifier: Apache-2.0
 */

#include <zephyr/kernel.h>
#include <zephyr/sys/printk.h>
#include <zephyr/usb/usb_device.h>

int main(void)
{
	int ret;

	ret = usb_enable(NULL);
	if (ret != 0) {
		printk("Failed to enable USB");
		return 0;
	}

	printk("BLE Dongle Firmware\n");
	return 0;
}
```
